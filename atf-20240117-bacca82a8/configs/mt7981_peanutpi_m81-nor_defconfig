## atf-20240117-bacca82a8/configs/mt7981_peanutpi_m81-nor_defconfig
```kconfig
# Platform
CONFIG_PLAT_MT7981=y

# Target
CONFIG_TARGET_ALL_NO_SEC_BOOT=y
CONFIG_FLASH_DEVICE_SPIM_NOR=y

# DRAM
CONFIG_DRAM_DDR4=y
CONFIG_BGA=y

# Log
CONFIG_LOG_LEVEL_INFO=y
```

## atf-20240117-bacca82a8/configs/mt7981_peanutpi_m81-sd_defconfig
```kconfig
# Platform
CONFIG_PLAT_MT7981=y

# Target
CONFIG_TARGET_ALL_NO_SEC_BOOT=y
CONFIG_FLASH_DEVICE_SDMMC=y

# DRAM
CONFIG_DRAM_DDR4=y

# Log
CONFIG_LOG_LEVEL_INFO=y
```

## uboot-mtk-20250711/configs/mt7981_melonpi_m81-pro_defconfig
```kconfig
# Architecture / Platform
CONFIG_ARM=y
CONFIG_ARCH_MEDIATEK=y
CONFIG_TARGET_MT7981=y
CONFIG_POSITION_INDEPENDENT=y
CONFIG_SYS_HAS_NONCACHED_MEMORY=y

# Board / Device Tree
CONFIG_DEFAULT_DEVICE_TREE="mt7981b-melonpi_m81-pro"
CONFIG_DEFAULT_FDT_FILE="mt7981-spim-nand-rfb"
CONFIG_OF_EMBED=y

# Memory Layout
CONFIG_TEXT_BASE=0x41e00000
CONFIG_SYS_LOAD_ADDR=0x46000000
CONFIG_SYS_MALLOC_F_LEN=0x4000
CONFIG_NR_DRAM_BANKS=1

# Console / Shell
CONFIG_SYS_PROMPT="MT7981> "
CONFIG_HUSH_PARSER=y
CONFIG_SYS_CBSIZE=512
CONFIG_SYS_PBSIZE=1049

# Debug
CONFIG_DEBUG_UART=y
CONFIG_DEBUG_UART_BASE=0x11002000
CONFIG_DEBUG_UART_CLOCK=40000000
CONFIG_LOG=y
CONFIG_LOGLEVEL=7

# Boot Menu / Recovery
CONFIG_MEDIATEK_BOOTMENU=y
CONFIG_MEDIATEK_BOOTMENU_DELAY=3
CONFIG_MTK_WEB_FAILSAFE=y
CONFIG_MTK_WEB_FAILSAFE_AFTER_BOOT_FAILURE=y
CONFIG_AUTOBOOT_MENU_SHOW=y
CONFIG_AUTOBOOT_MENU_MTK_SHOW=y
CONFIG_CMD_BOOTMENU=y

# Image / Upgrade
CONFIG_FIT=y
CONFIG_MTK_UBI_SUPPORT=y
CONFIG_MTK_UPGRADE_BL2_VERIFY=y
# CONFIG_MTK_UPGRADE_IMAGE_VERIFY is not set

# Environment
CONFIG_ENV_IS_IN_MTD=y
CONFIG_ENV_MTD_NAME="u-boot-env"

CONFIG_ENV_OFFSET=0x0
CONFIG_ENV_SIZE=0x20000
CONFIG_ENV_SIZE_REDUND=0x80000

CONFIG_ENV_OVERWRITE=y
CONFIG_ENV_VARS_UBOOT_RUNTIME_CONFIG=y

# Flash / MTD / NAND
CONFIG_DM_MTD=y
CONFIG_MTD_SPI_NAND=y
CONFIG_ENABLE_NAND_NMBM=y

CONFIG_CMD_MTD=y
CONFIG_CMD_MTDPARTS=y
CONFIG_CMD_NMBM=y

CONFIG_MTDIDS_DEFAULT="nmbm0=nmbm0"
CONFIG_MTDPARTS_DEFAULT="nmbm0:1024k(bl2),512k(u-boot-env),2048k(Factory),2048k(fip),114688k(ubi)"

# Networking
CONFIG_MEDIATEK_ETH=y
CONFIG_PHY_FIXED=y
CONFIG_NET_RANDOM_ETHADDR=y

CONFIG_USE_IPADDR=y
CONFIG_IPADDR="192.168.1.1"

CONFIG_USE_NETMASK=y
CONFIG_NETMASK="255.255.255.0"

CONFIG_USE_SERVERIP=y
CONFIG_SERVERIP="192.168.1.2"

CONFIG_PROT_TCP=y

# Network Commands
CONFIG_CMD_PING=y
CONFIG_CMD_TFTPPUT=y

# Command Support
CONFIG_CMD_MEMINFO=y
CONFIG_CMD_GPIO=y
CONFIG_CMD_GPIO_READ=y
CONFIG_CMD_PWM=y
CONFIG_CMD_SMC=y
CONFIG_CMD_GL_BTN=y

# GPIO / Button / LED
CONFIG_BUTTON=y
CONFIG_BUTTON_GPIO=y

CONFIG_LED=y
CONFIG_LED_BLINK=y
CONFIG_LED_GPIO=y

# Clock / Timer
CONFIG_CLK=y
CONFIG_TIMER=y
CONFIG_MTK_TIMER=y

# Pin Control / Power
CONFIG_PINCTRL=y
CONFIG_PINCONF=y
CONFIG_PINCTRL_MT7981=y

CONFIG_POWER_DOMAIN=y
CONFIG_MTK_POWER_DOMAIN=y

# Regulator
CONFIG_DM_REGULATOR=y
CONFIG_DM_REGULATOR_FIXED=y
CONFIG_DM_REGULATOR_GPIO=y

# PWM
CONFIG_DM_PWM=y
CONFIG_PWM_MTK=y

# Serial UART
CONFIG_DM_SERIAL=y
CONFIG_MTK_SERIAL=y

# SPI
CONFIG_SPI=y
CONFIG_DM_SPI=y
CONFIG_MTK_SPIM=y

# System Framework
CONFIG_REGMAP=y
CONFIG_SYSCON=y

# Crypto / Utility
CONFIG_HEXDUMP=y
CONFIG_MD5=y

# Disabled Features

# CONFIG_I2C is not set
# CONFIG_DM_I2C is not set
# CONFIG_I2C_SET_DEFAULT_BUS_NUM is not set

# CONFIG_MMC is not set
# CONFIG_PCIE_MEDIATEK is not set
# CONFIG_EFI_LOADER is not set

# CONFIG_CMD_ELF is not set
# CONFIG_CMD_XIMG is not set
# CONFIG_CMD_UNLZ4 is not set
# CONFIG_CMD_UNZIP is not set

# CONFIG_BOOTM_NETBSD is not set
# CONFIG_BOOTM_PLAN9 is not set
# CONFIG_BOOTM_RTEMS is not set
# CONFIG_BOOTM_VXWORKS is not set
```
